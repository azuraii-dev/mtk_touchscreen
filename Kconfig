## Kconfig
```kconfig
#
# Touchscreen driver configuration
#
menuconfig TOUCHSCREEN_MTK
	tristate "Touchscreens"
	help
	  Say Y here, and a list of supported touchscreens will be displayed.
	  This option doesn't affect the kernel.

	  If unsure, say Y.

if TOUCHSCREEN_MTK

config TOUCHSCREEN_MTK_HODAFONEHW
	tristate "MediaTek Touch Panel Driver for hodafonehw"
	help
	  Say Y here if you have MediaTek touch panel.

	  If unsure, say N.

	  To compile this dirver as a module, choose M here: the
	  module will be called.

source "drivers/input/touchscreen/mtk_touchscreen_hodafonehw/synaptics_dsx/Kconfig"
source "drivers/input/touchscreen/mtk_touchscreen_hodafonehw/q20_touch/Kconfig"

endif
```

## q20_touch/Kconfig
```kconfig
#
# q20 touchscreen driver configuration
#
config TOUCHSCREEN_Q20_TOUCH
	tristate "q20 tp chip for Mediatek package"
	default n
	depends on I2C && OF
	help
	  Say Y here if you have gigadevice touch panel.
	  If unsure, say N.
	  To compile this dirver as a module, choose M here: the
	  module will be called.
```
